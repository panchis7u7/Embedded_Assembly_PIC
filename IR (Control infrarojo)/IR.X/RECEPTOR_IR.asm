#INCLUDE <P16F887.INC>
 LIST P=16F887
; CONFIG1
; __config 0xFFE1
 __CONFIG _CONFIG1, _FOSC_HS & _WDTE_OFF & _PWRTE_ON & _MCLRE_ON & _CP_OFF & _CPD_OFF & _BOREN_ON & _IESO_ON & _FCMEN_ON & _LVP_ON
; CONFIG2
; __config 0xFFFF
 __CONFIG _CONFIG2, _BOR4V_BOR40V & _WRT_OFF
 
 CBLOCK 
 ENDC
 ORG 0x00
    CALL IRsetup
REC:
    BTFSC PORTA,4
    GOTO ACT_RLF
    GOTO REC
ACT_RLF:
    BTFSC PORTA,4
    GOTO ACT_RLF
    MOVLW D'255'
    CALL IRcarrier  ;9ms de carrier
    MOVLW D'110'
    CALL IRcarrier
    CALL RETARDO_5MS_16
    MOVLW 0x00
    CALL IRsend
    MOVLW 0xFF
    CALL IRsend
    MOVLW 0xA2
    CALL IRsend
    MOVLW 0x5D
    CALL IRsend
GOTO REC
    #INCLUDE <RETARDOS_16MHZ.inc>
    ;#INCLUDE <RETARDOS_TMR0.inc>
    #INCLUDE <IR.inc>
 END


