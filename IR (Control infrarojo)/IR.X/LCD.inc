    CBLOCK
    memocaracter
    memoriaw
    caractertemp
    ENDC
    
DATOS EQU PORTD	;LINEAS DE DATOS
PINLCD EQU PORTD    ;LINEAS DE CONTROL
 
RS EQU 1    ;LINEA DE CONTROL RS 
RW EQU 2	;LINEA DE CONTROL RW
E EQU 3	;LINEA DE OCNTROL E
 
ON_DISPLAY_CURSOR_BLINK EQU 0FH	;ACTIVA EL DISPLAY, EL CURSOR Y HACE PARPADEO
SOLO_DISPLAY EQU 0CH		;APAGA EL CURSOR Y SU PARPADEO
LIMPIAR_LCD EQU 01H			;LIMPIA LOS CARACTERES DE LA PANTALLA
APAGAR_DISPLAY  EQU 08H		;APAGA LA PANTALLA
SALTO_ENTER EQU D'192'			;SE DIRIGE A LA SEGUNDA LINEA
HOME_INICIO EQU 02H			;VUELVE AL INICIO
MOVER_CURSOR_IZQ EQU 10H		;MUEVE EL CURSOR A LA IZQUIERDA
MOVER_CURSOR_DERECHA EQU 14H	;MUEVE EL CURSOR A LA DERECHA
MOVER_PANTALLA_IZQ EQU 18H		;MUEVE LA PANTALLA A LA IZQUIERDA
MOVER_PANTALLA_DERECHA EQU 1CH	;MUEVE LA PANTALLA A LA DERECHA
OFF EQU 0
ON EQU 1
ESCRIBIR_COMANDO:
    MOVWF memocaracter
    CALL COMPROBAR_OCUPADO
    MOVF memocaracter,W
    ANDLW B'11110000'
    MOVWF DATOS
    BCF PINLCD,RW
    BCF PINLCD,E
    NOP
    BSF PINLCD,E
    NOP
    BCF PINLCD,E
    SWAPF memocaracter,W
    ANDLW B'11110000'
    MOVWF DATOS
    NOP
    BSF PINLCD,E
    NOP
    BCF PINLCD,E
    RETURN
    
COMPROBAR_OCUPADO:
    BSF STATUS,RP0
    BCF STATUS,RP1
    MOVLW B'11110000'
    MOVWF TRISD
    BCF STATUS,RP0
    BCF STATUS,RP1
    BCF PINLCD,RS
    BSF PINLCD,RW
    NOP
    BSF PINLCD,E
    NOP
    MOVF DATOS,W
    BCF PINLCD,E
    ANDLW 0FH
    MOVWF caractertemp
    NOP
    BSF PINLCD,E
    NOP
    SWAPF DATOS,W
    BCF PINLCD,E
    ANDLW 0FH
    IORWF caractertemp,1
    BTFSC caractertemp,7
    GOTO COMPROBAR_OCUPADO
    BSF PINLCD,RW
    BSF STATUS,RP0
    BCF STATUS,RP1
    MOVLW 0x00
    MOVWF TRISD
    BCF STATUS,RP0
    BCF STATUS,RP1
    RETURN

ESCRIBIR_CARACTER:
    MOVWF memoriaw
    MOVWF memocaracter
    CALL COMPROBAR_OCUPADO
    MOVF memocaracter,W
    ANDLW B'11110000'
    MOVWF DATOS
    BCF PINLCD,RW
    BSF PINLCD,RS
    NOP
    BSF PINLCD,E
    NOP
    BCF PINLCD,E
    SWAPF memocaracter,W
    ANDLW B'11110000'
    MOVWF DATOS
    BCF PINLCD,RW
    BSF PINLCD,RS
    NOP
    BSF PINLCD,E
    NOP
    BCF PINLCD,E
    MOVF memoriaw,W
    RETURN
    
INICIALIZACION_DE_PANTALLA: ;SUBRUTINA DE SECUENCIA PARA INICIAR EL LCD
    BCF STATUS,RP0	    ;BANCO 0
    BCF STATUS,RP1
    BCF PINLCD,E	    ;SE APAGA EL PIN E
    BCF PINLCD,RW	    ;SE APAGA EL PIN RW
    BCF PINLCD,RS	    ;SE APAGA EL PIN RS
    MOVLW 0x0F		    ;ENCENDEMOS LOS PINES DEL LCD
    MOVWF DATOS		    ;EN EL PUERTO D
    BSF STATUS,RP0	    ;BANCO 1
    BCF STATUS,RP1
    MOVLW B'00001111'	    ;TODOS LOS PINES DEL PUERTO D SON DECLARADOS COMO SALIDA
    MOVWF TRISD
    BCF TRISD,E		    ;EL PIN E ES SALIDA
    BCF TRISD,RW	    ;EL PIN RW ES SALIDA
    BCF TRISD,RS	    ;EL PIN RS ES SALIDA
    BCF STATUS,RP0	    ;BANCO 0
    BCF STATUS,RP1
    CALL RETARDO_20MICROS
    MOVLW B'00110000'	    ;PRIMER VALOR PEDIDO POR EL FABRICANTE
    MOVWF DATOS		    ;LO ESCRIBIMOS EN EL PUERTOD
    NOP
    BSF PINLCD,E	    ;IMPULSO AL PIN ENABLE
    NOP			    ;ANCHO DE PULSO DE 0.2US
    BCF PINLCD,E	    ;FIN DEL IMPULSO
    CALL RETARDO_5MS
    MOVLW B'00110000'	    ;SEGUNDO PEDIDO POR EL FABRICANTE
    MOVWF DATOS		    ;LO ESCRIBIMOS EN EL PUERTO D
    NOP
    BSF PINLCD,E	    ;PULSO AL PIN ENABLE
    NOP			    ;ANCHO DE PULSO DE 0.2US
    BCF PINLCD,E	    ;FIN DE PULSO
    MOVLW B'00110000'	    ;TERCER VALOR PEDIDO POR EL FABRICANTE
    MOVWF DATOS		    ;LO ESCRIBIMOS EN EL PUERTO D
    NOP
    BSF PINLCD,E	    ;PULSO AL PIN ENABLE
    NOP
    BCF PINLCD,E	    ;FIN DE PULSO
    CALL RETARDO_200MICROS
    CALL RETARDO_20MICROS
    MOVLW B'00100000'	    ;CARGAMOS COMANDO DE CONFIGURACION DE COMUNICACION DE 4 BITS
    MOVWF DATOS		    ;ESCRIBIMOS COMANDO EN EL PUERTOD
    NOP
    BSF PINLCD,E	    ;PULSO AL PIN ENABLE
    NOP
    BCF PINLCD,E	    ;FIN DE PULSO
    MOVLW B'00101000'
    CALL ESCRIBIR_COMANDO
    MOVLW ON_DISPLAY_CURSOR_BLINK
    CALL ESCRIBIR_COMANDO
    MOVLW LIMPIAR_LCD
    CALL ESCRIBIR_COMANDO
    MOVLW B'00000110'
    CALL ESCRIBIR_COMANDO
    MOVLW B'10000000'
    CALL ESCRIBIR_COMANDO
    RETURN