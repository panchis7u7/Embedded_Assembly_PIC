 ;PROCESSOR P16F73
 #INCLUDE <P16F73.INC>
 LIST P=16F73
; CONFIG
; __config 0xFFF2
 __CONFIG _FOSC_HS & _WDTE_OFF & _PWRTE_ON & _CP_OFF & _BOREN_ON
 
 START_PASSED EQU 0x1
 END_RECV EQU 0x2
 
 CBLOCK 0x20
    IR_FLAGS
    CONTADOR
    CONTADOR_2
    REC_BYTE1
    REC_BYTE2
    ;UART
    GUARDA_W
    GUARDA_STATUS
    ;TEMP
    CONTADOR_TIEMPO
 ENDC
 
    ORG 0
    GOTO SETUP		    ;PREPARACION.
    ORG 4
    GOTO INT_HANDLE	    ;RECEPCION IR.
    ;GOTO INTERRUPCION
SETUP:
    BSF STATUS,RP0	    ;BANCO 1.
    BCF STATUS, RP1	    
    ;MOVLW B'00100000'	    ;HABILITA LA INTERRUPCION PARA RX (RECEPCION SERIAL) EN EUSART.
    ;MOVWF PIE1		    ;HABILITACION DE INTERRUPCION PARA RX.
    MOVLW B'00000011'	    ;PRESCALLER:16.
    MOVWF OPTION_REG
    CLRF PIE2
    ;MOVLW B'00000000'	    ;PUERTO RX COMO ENTRADA Y CCP1,CCP2/PWM 1KHz.
    ;MOVWF TRISC
    CLRF TRISC
    ;MOVLW B'00100100'
    ;MOVWF TXSTA
    ;MOVLW D'207'	    ;RESULTADO DEL CALCULO PARA 2400 BAUDIOS. (RF).
    ;MOVWF SPBRG
    CLRF TRISB		    ;SALIDA PARA LOS LEDS. (RB1, RB2 Y RB3)
    BSF TRISB,0		    ;RBO/INT -> ENTRADA PARA INTERRUPCION PARA DETECCION DE CODIGO IR
    BSF TRISB,4
    MOVLW D'249'
    MOVWF PR2
    BCF STATUS,RP0	    ;BANCO 0.
    BCF STATUS,RP1	    ;CONFIGURACION DEL PUERTO RX.
    CLRF T1CON
    CLRF PIR1
    CLRF PIR2
    ;MOVLW B'10010000'
    ;MOVWF RCSTA
    ;MOVLW B'11000000'	    ;CONFIGURACION PARA INTERRUPCION RX.
    ;MOVWF INTCON	    ;INTERRUPCION EUSART, PEIE Y GIE. (RF)
    MOVLW B'10010000'	    ;HABILITACION DE INTERRUPCION EXTERNA (RBO/INT)
    MOVWF INTCON
    MOVLW B'00001100'
    MOVWF CCP1CON
    MOVWF CCP2CON
    MOVLW D'204'
    MOVWF CCPR1L
    MOVLW D'0'
    MOVWF CCPR2L
    MOVLW B'00000101'
    MOVWF T2CON
    CLRF PORTB
    ;MOVF RCREG,W	    ;Flush receive buffer
    ;MOVF RCREG,W
    ;MOVF RCREG,W
    CLRF CONTADOR
    CLRF CONTADOR_2
    CLRF CONTADOR_TIEMPO
    CLRF REC_BYTE1
    CLRF REC_BYTE2
    CLRF IR_FLAGS
    CLRF GUARDA_W
    CLRF GUARDA_STATUS
    GOTO PROGRAMA

;-------------------------------------------------------------------------------
;ESPERA AQUI HASTA QUE EL USUARIO HAGA UNA DESICION DEL MENU.
ESPERA_CMD:
    BCF IR_FLAGS,END_RECV
ESPERA_CMD_NUEVO:
    BTFSC IR_FLAGS,END_RECV
    GOTO PROGRAMA
    GOTO ESPERA_CMD_NUEVO
;MENU DE DESICIONES.
;-------------------------------------------------------------------------------

;-------------------------------------------------------------------------------
;CHECAR SI LOS CODIGOS RECIBIDOS CORRESPONDEN A ALGUN COMANDO.
PROGRAMA:
    CLRF CONTADOR_2
    BANKSEL REC_BYTE1
    MOVFW REC_BYTE1
    XORLW 0x00
    BTFSS STATUS,Z
    GOTO CHECK_CAMBIO_DUTY
    BANKSEL REC_BYTE2
    MOVFW REC_BYTE2
    XORLW 0x10
    BTFSC STATUS,Z
    GOTO CAMBIO_COLOR

CHECK_CAMBIO_DUTY:
    BANKSEL REC_BYTE1
    MOVFW REC_BYTE1
    XORLW 0x08
    BTFSS STATUS,Z
    GOTO CHECK_CAMBIO_AUTO
    BANKSEL REC_BYTE2
    MOVFW REC_BYTE2
    XORLW 0x10
    BTFSC STATUS,Z
    GOTO CAMBIO_DUTY

CHECK_CAMBIO_AUTO:
    BANKSEL REC_BYTE1
    MOVFW REC_BYTE1
    XORLW 0x04
    BTFSS STATUS,Z
    GOTO ESPERA_CMD
    BANKSEL REC_BYTE2
    MOVFW REC_BYTE2
    XORLW 0x10
    BTFSC STATUS,Z
    GOTO CAMBIO_AUTO
    BANKSEL REC_BYTE1
    CLRF REC_BYTE1
    BANKSEL REC_BYTE2
    CLRF REC_BYTE2
    GOTO ESPERA_CMD
;FIN DE COMPARACION DE CODIGOS DISPONIBLES.
;-------------------------------------------------------------------------------

;-------------------------------------------------------------------------------
;MODO MANUAL DE CAMBIO DE COLOR.
CAMBIO_COLOR:
    MOVLW D'255'
    MOVWF CCPR2L
    BANKSEL CONTADOR
    INCF CONTADOR,1
    MOVFW CONTADOR
    ANDLW D'7'
    RLF W
    MOVWF PORTB
    GOTO ESPERA_CMD
;FIN FUNCION
;-------------------------------------------------------------------------------

;-------------------------------------------------------------------------------
;CAMBIO DE BRILLO DEL LED.
CAMBIO_DUTY:
    MOVLW D'51'
    ADDWF CCPR1L,1
    GOTO ESPERA_CMD
;FIN FUNCION.
;-------------------------------------------------------------------------------

;-------------------------------------------------------------------------------
;MODO DE CAMBIO AUTOMATICO DE COLORES.
CAMBIO_AUTO:
    BCF IR_FLAGS,END_RECV
    MOVLW 0x00
    MOVWF CCPR2L
REPETICION:
    BANKSEL CONTADOR
    INCF CONTADOR,1
    MOVFW CONTADOR
    ANDLW D'7'
    RLF W
    MOVWF PORTB
    BANKSEL CONTADOR_TIEMPO
    MOVLW 0xFF
    MOVWF CONTADOR_TIEMPO
LED_BRILLO:
    BTFSC IR_FLAGS,END_RECV
    GOTO ESPERA_CMD
    CALL CAMBIO_RETARDO_15MS
    INCF CCPR2L,1
    DECFSZ CONTADOR_TIEMPO,F
    GOTO LED_BRILLO
    CALL CAMBIO_RETARDO_15MS
    MOVLW 0xFF
    MOVWF CONTADOR_TIEMPO
LED_APAGADO:
    BTFSC IR_FLAGS,END_RECV
    GOTO ESPERA_CMD
    CALL CAMBIO_RETARDO_15MS
    DECF CCPR2L,1
    DECFSZ CONTADOR_TIEMPO,F
    GOTO LED_APAGADO
    GOTO REPETICION
;FIN FUNCION.
;-------------------------------------------------------------------------------

;INTERRUPCION PARA RECEPCION DE DATOS A TRAVES DEL USART. (RF)
;INTERRUPCION:
;    MOVWF GUARDA_W
;    SWAPF STATUS,W
;    MOVWF GUARDA_STATUS
;    BCF STATUS,RP0
;    BCF STATUS,RP1
;GUARDADO:
;    BTFSS PIR1,RCIF	    ;CHECAR SI LA INTERRUPCION ES DEL USART.
;    GOTO EXIT 
;    BTFSC UART,RX_BYTE	    ;SI RX_BIT ESTA ALTO, ENTONCES RXREG NO SE HA PROCESADO AUN.
;    GOTO EXIT
;    MOVFW RCREG		    ;Read input byte into W
;    MOVWF TEMP		    ;Store received byte to shared RAM
;    BSF UART,RX_BYTE
;    MOVFW RCREG		    ;PUEDE HABER UN SEGUNDO BYTE.
;    BCF RCSTA,CREN
;    BSF RCSTA,CREN
;EXIT:
;    MOVFW RCREG
;    MOVFW RCREG
;    SWAPF GUARDA_STATUS,W
;    MOVWF STATUS
;    SWAPF GUARDA_W,F
;    SWAPF GUARDA_W,W
;    RETFIE

;-------------------------------------------------------------------------------
;INTERRUPCION PARA RECEPCION DE DATOS A TRAVES DE SALIDA EXTERNA. (IR)
INT_HANDLE:
    MOVWF GUARDA_W
    SWAPF STATUS,W
    MOVWF GUARDA_STATUS
    BCF STATUS,RP0
HANDLE:
    INCF CONTADOR_2,1
    BTFSC IR_FLAGS,START_PASSED
    GOTO IR_RCV
    CALL RETARDO_2500MICROS
    BTFSS PORTB,4
    GOTO VERIFICACION_2
    BSF IR_FLAGS,START_PASSED
    GOTO VERIFICACION_2
IR_RCV:
    BCF IR_FLAGS,END_RECV
    CALL RETARDO_900MICROS
    BTFSS PORTB,4
    GOTO UNO
CERO:
    BCF STATUS,C
    RLF REC_BYTE2
    RLF REC_BYTE1
    BCF STATUS,C
    GOTO VERIFICACION_2
UNO:
    BSF STATUS,C
    RLF REC_BYTE2
    RLF REC_BYTE1
    BCF STATUS,C
VERIFICACION_2:
    BANKSEL CONTADOR_2
    MOVFW CONTADOR_2
    XORLW D'12'
    BTFSC STATUS,Z
    BSF IR_FLAGS,END_RECV
    SWAPF GUARDA_STATUS,W
    MOVWF STATUS
    SWAPF GUARDA_W,F
    SWAPF GUARDA_W,W
    BCF INTCON,INTF
    RETFIE
;FIN INTERRUPCION.
;-------------------------------------------------------------------------------
    
;RETARDO DE 2.5MS USANDO TIMER0.
RETARDO_2500MICROS:
    BCF INTCON,T0IF
    MOVLW D'100'
    MOVWF TMR0
COMPROBAR:
    BTFSS INTCON,T0IF
    GOTO COMPROBAR
    RETURN
    
;RETARDO DE 900 MICROS USANDO TIMER0.
RETARDO_900MICROS:
    BCF INTCON,T0IF
    MOVLW D'200'
    MOVWF TMR0
COMPROBAR_2:
    BTFSS INTCON,T0IF
    GOTO COMPROBAR_2
    RETURN

;TIEMPO ENTRE CAMBIO DE COLORES EN EL MODO AUTOMATICO DEL LED RGB.
CAMBIO_RETARDO_15MS:   
    BCF T1CON,TMR1ON
    MOVLW 0x65
    MOVWF TMR1H
    MOVLW 0x68
    MOVWF TMR1L
    BSF T1CON,TMR1ON
RETARDO_15MS_4_0:
    BTFSS PIR1,TMR1IF
    GOTO RETARDO_15MS_4_0
    BCF T1CON,TMR1ON
    BCF PIR1,TMR1IF
    RETURN
    
    END

