    PROCESSOR 16F887
    #INCLUDE <P16F887.INC>
    LIST P=16F887
    ; CONFIG1
    ; __config 0xFFE2
     __CONFIG _CONFIG1, _FOSC_XT & _WDTE_OFF & _PWRTE_ON & _MCLRE_OFF & _CP_OFF & _CPD_OFF & _BOREN_ON & _IESO_ON & _FCMEN_ON & _LVP_ON
    ; CONFIG2
    ; __config 0xFFFF
    __CONFIG _CONFIG2, _BOR4V_BOR40V & _WRT_OFF
    CBLOCK
    ENDC
    ORG 0x00
 INICIO:
    BSF STATUS,RP0  
    BCF STATUS,RP1
    BCF TRISD,0
    BCF STATUS, RP0
    MOVLW D'00110000'
    MOVWF T1CON
 PROGRAMA:
    BSF PORTD,0
    CALL RETARDO_500MST1
    BCF PORTD,0
    CALL RETARDO_500MST1
    GOTO PROGRAMA
    
 RETARDO_500MST1:
    BCF T1CON,TMR1ON
    MOVLW 0xB
    MOVWF TMR1H
    MOVLW 0xDC
    MOVWF TMR1L
    BSF T1CON,TMR1ON
 COMPROBAR:
    BTFSS PIR1,TMR1IF
    GOTO COMPROBAR
    BCF PIR1,TMR1IF
    RETURN
    END

