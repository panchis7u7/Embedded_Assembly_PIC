    PROCESSOR 16F887
    #INCLUDE <P16F887.INC>
    LIST P=16F887
    ; CONFIG1
    ; __config 0xE3E2
    __CONFIG _CONFIG1, _FOSC_HS & _WDTE_OFF & _PWRTE_ON & _MCLRE_ON & _CP_OFF & _CPD_OFF & _BOREN_ON & _IESO_OFF & _FCMEN_OFF & _LVP_OFF
    ;    CONFIG2
    ; __config 0xFFFF
    __CONFIG _CONFIG2, _BOR4V_BOR40V & _WRT_OFF
    CBLOCK 0x20
    ENDC
    ORG 0
    GOTO INICIO
    ORG 5
INICIO
    BSF STATUS,RP0
    BCF STATUS,RP1
    MOVLW B'00000000'
    ;MOVLW B'01101110'
    ;MOVWF OSCCON
    ;CLRF OSCTUNE
    ;MOVLW 0xFF
    MOVLW TRISD
    BCF STATUS,RP0
    BCF STATUS,RP1
    CLRF PORTD
    CALL RETARDO_50MICROS
    CALL INICIALIZACION_DE_PANTALLA 
    CALL RETARDO_50MICROS
START
    MOVLW 'H'
    CALL ESCRIBIR_CARACTER
    MOVLW 'O'
    CALL ESCRIBIR_CARACTER
    MOVLW 'L'
    CALL ESCRIBIR_CARACTER
    MOVLW 'A'
    CALL ESCRIBIR_CARACTER
    MOVLW ' '
    CALL ESCRIBIR_CARACTER
    MOVLW 'M'
    CALL ESCRIBIR_CARACTER
    MOVLW 'U'
    CALL ESCRIBIR_CARACTER
    MOVLW 'N'
    CALL ESCRIBIR_CARACTER
    MOVLW 'D'
    CALL ESCRIBIR_CARACTER
    MOVLW 'O'
    CALL ESCRIBIR_CARACTER
    MOVLW '!'
    CALL ESCRIBIR_CARACTER
    MOVLW SOLO_DISPLAY
    CALL ESCRIBIR_COMANDO
    ;CALL RETARDO_2S
    ;MOVLW LIMPIAR_LCD
    ;CALL ESCRIBIR_COMANDO
    ;CALL RETARDO_2S
    ;GOTO START
    GOTO $
    #INCLUDE <RETARDOS.INC>
    #INCLUDE <LCD.INC>  
    END