#INCLUDE <P16F887.INC>
LIST P=16F887
; CONFIG1
; __config 0xFFE1
 __CONFIG _CONFIG1, _FOSC_XT & _WDTE_OFF & _PWRTE_ON & _MCLRE_ON & _CP_OFF & _CPD_OFF & _BOREN_ON & _IESO_ON & _FCMEN_ON & _LVP_ON
; CONFIG2
; __config 0xFFFF
 __CONFIG _CONFIG2, _BOR4V_BOR40V & _WRT_OFF
CBLOCK
    CONTADOR
 ENDC
 ORG 0
    BSF STATUS,RP0	
    BCF STATUS,RP1	;BANCO 1.
    CLRF TRISD		;SE DECLARAN TODOS LOS PINES DEL PUERTO D COMO SALIDA.
    BSF TRISA,0		;SE DECLARA EL PIN RA0 COMO ENTRADA.
    MOVLW D'249'	;VALOR OBTENIDO DE PR2, 1KHz.
    MOVWF PR2		;MOVER EL VALOR A PR2.
    BCF TRISC, 2	;RC2 -> CCP1 COMO SALIDA. 
    BSF STATUS,RP0	;BANCO 3.
    BSF STATUS,RP1
    BSF ANSEL,0		;AN0 TIENE ENTRADA ANALOGICA.
    CLRF ANSELH		;TODOS LO PINES DIFERENTES A AN0 SON DIGITALES.
    BSF STATUS,RP0	;BANCO 1.
    BCF STATUS,RP1
    CLRF ADCON1		;JUSTIFICACION A LA IZQUIERDA.
    BCF STATUS,RP0	;BANCO 0.
    BCF STATUS,RP1
    MOVLW B'00000001'	;FOSC/2, AN0, ADC ENABLE 1.
    MOVWF ADCON0
DELAY:
    MOVLW D'19'		
    MOVWF CONTADOR
DELAY_BUCLE:		;TIEMPO DE ADQUISICION.
    DECFSZ CONTADOR,1
    GOTO DELAY_BUCLE	
    BSF ADCON0,GO	;EL ADC EMPIEZA CON LA CONVERSION.
ADC_INICIO:
    BTFSS PIR1, ADIF	;CHECA SI EL ADC TERMINO CON LA CONVERSION.
    GOTO ADC_INICIO	;SI NO HA TERMINADO, REPITE.
    ;MOVLW D'125'	;DUTY CUCLE 50% DE 1KHz ABS(249 / 2).
    ;MOVWF CCPR1L	;MOVER DUTY CYCLE A CCPR1L.
    ;MOVF ADRESH, CCPR1L
    MOVFW ADRESH	;8 MSB DE LA CONVERION DEL ADC SE MUEVEN AL REGISTRO W. 
    MOVWF CCPR1L	;EL VALOR DE ADRESH (W) SE MUEVE AL REGISTRO DEL CONTROL DE DC.
    MOVLW B'00001100'	;CONFIG DE CCP1CON.
    MOVWF CCP1CON	;MOVER LA CONFIGURACION A CCP1CON.
    MOVLW B'00000101'	;CONFIG T2CON, POSTSCALER = 0, PRESCALER = 4, TIMER2 ON.
    MOVWF T2CON		;MOVER LA CONFIGURACION AL T2CON.
    GOTO DELAY		;REPITE, PARA OTROS VALORES DEL POTENCIOMETRO.
 END