;--------------------------------- PINOUT --------------------------------------
;   PIC16F887
;   4MHz
;   RD1 -> RS (LCD 20x4)
;   RD2 -> RW (LCD 20x4)
;   RD3 -> E  (LCD 20x4)
;   RD4 -> D4 (LCD 20x4)
;   RD5 -> D5 (LCD 20x4)
;   RD6 -> D6 (LCD 20x4)
;   RD7 -> D7 (LCD 20x4)    
;   RB0 -> OUT_IR
;   RB4 -> OUT_IR
;   V0 (LCD 20x4) -> POT 10K
;-------------------------------------------------------------------------------
#INCLUDE <P16F887.INC>
LIST P=16F887
#INCLUDE <MACROS.INC>
; CONFIG1
; __config 0x2FC2
 __CONFIG _CONFIG1, _FOSC_HS & _WDTE_OFF & _PWRTE_ON & _MCLRE_OFF & _CP_OFF & _CPD_OFF & _BOREN_ON & _IESO_ON & _FCMEN_ON & _LVP_OFF
; CONFIG2
; __config 0x3FFF
 __CONFIG _CONFIG2, _BOR4V_BOR40V & _WRT_OFF
 
 START_PASSED EQU 0x1
 
 CBLOCK 0x20
    IR_FLAGS
    DIGITO
    TEMP
    CONTADOR
    CONTADOR_2
    REC_BYTE1
    REC_BYTE2
    GUARDA_W
    GUARDA_STATUS
ENDC

    ORG 0
    GOTO SETUP
    ORG 4
    GOTO INT_HANDLE
SETUP:
    LCD_INIT
    CALL IR_INIT
START:
    WRITE_LCD 'C'
    WRITE_LCD 'O'
    WRITE_LCD 'D'
    WRITE_LCD 'I'
    WRITE_LCD 'G'
    WRITE_LCD 'O'
    WRITE_LCD ':'
    CLRF CONTADOR
    MOVFW REC_BYTE1
    MOVWF TEMP
    CALL IMPRIMIR_VAR
    CLRF CONTADOR
    MOVFW REC_BYTE2
    MOVWF TEMP
    CALL IMPRIMIR_VAR
    ORIGIN_LCD
    ONLY_DISPLAY
    BANKSEL CONTADOR_2
PRUEBA:
    MOVFW CONTADOR_2
    XORLW D'13'
    BTFSS STATUS,Z
    GOTO PRUEBA
    BCF IR_FLAGS,START_PASSED
    CLRF CONTADOR_2
    GOTO START

IMPRIMIR_VAR:
    BCF STATUS,C
    INCF CONTADOR,1
    MOVLW D'9'
    MOVWF DIGITO
    SWAPF TEMP,1
    MOVFW TEMP
    ANDLW 0xF
    SUBWF DIGITO,1
    BTFSC STATUS,C
    GOTO DECIMAL
    GOTO HEXADECIMAL
DECIMAL:
    MOVWF DIGITO
    WRITE_LCD_REG DIGITO
    GOTO VERIFICACION
HEXADECIMAL:
    MOVWF DIGITO
    WRITE_LCD_REG_HEX DIGITO
VERIFICACION:
    MOVFW CONTADOR
    XORLW D'2'
    BTFSS STATUS,Z
    GOTO IMPRIMIR_VAR
    CLRF CONTADOR
    RETURN
    
IR_INIT: 
    BSF STATUS,RP0
    BSF STATUS,RP1
    CLRF ANSEL
    CLRF ANSELH
    BSF STATUS,RP0
    BCF STATUS,RP1
    BSF TRISB,0		; IR is input
    BSF TRISB,4		;Comparator Input
    CLRF TRISD
    MOVLW B'00000011'	;PRESCALLER:16.
    MOVWF OPTION_REG
    BCF STATUS,RP0      ; Select memory bank 0
    MOVLW B'10010000'
    MOVWF INTCON
    CLRF PORTD
    CLRF REC_BYTE1
    CLRF REC_BYTE2
    CLRF CONTADOR
    CLRF CONTADOR_2
    CLRF IR_FLAGS
    RETURN
    
INT_HANDLE:
    MOVWF GUARDA_W
    SWAPF STATUS,W
    MOVWF GUARDA_STATUS
    BCF STATUS,RP0
HANDLE:
    INCF CONTADOR_2,1
    BTFSC IR_FLAGS,START_PASSED
    GOTO IR_RCV
    CALL RETARDO_2500MICROS
    BTFSS PORTB,4
    GOTO VERIFICACION_2
    BSF IR_FLAGS,START_PASSED
    GOTO VERIFICACION_2
IR_RCV:
    CALL RETARDO_900MICROS
    BTFSS PORTB,4
    GOTO UNO
CERO:
    BCF STATUS,C
    RLF REC_BYTE2
    RLF REC_BYTE1
    BCF STATUS,C
    GOTO VERIFICACION_2
UNO:
    BSF STATUS,C
    RLF REC_BYTE2
    RLF REC_BYTE1
    BCF STATUS,C
VERIFICACION_2:
    SWAPF GUARDA_STATUS,W
    MOVWF STATUS
    SWAPF GUARDA_W,F
    SWAPF GUARDA_W,W
    BCF INTCON,INTF
    RETFIE

;RETARDO DE 2.5MS USANDO TIMER0.
RETARDO_2500MICROS:
    BCF INTCON,T0IF
    MOVLW D'100'
    MOVWF TMR0
COMPROBAR:
    BTFSS INTCON,T0IF
    GOTO COMPROBAR
    RETURN
    
;RETARDO DE 900 MICROS USANDO TIMER0.
RETARDO_900MICROS:
    BCF INTCON,T0IF
    MOVLW D'200'
    MOVWF TMR0
COMPROBAR_2:
    BTFSS INTCON,T0IF
    GOTO COMPROBAR_2
    RETURN
    
    #INCLUDE <RETARDOS.inc>
    #INCLUDE <LCD20X4.inc>
    #INCLUDE <BCD.INC>
    END


