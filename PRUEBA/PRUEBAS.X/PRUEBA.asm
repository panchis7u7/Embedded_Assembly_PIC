#INCLUDE <P16F887.INC>
    LIST P=16F887
; CONFIG1
; __config 0xEFC2
 __CONFIG _CONFIG1, _FOSC_HS & _WDTE_OFF & _PWRTE_ON & _MCLRE_OFF & _CP_OFF & _CPD_OFF & _BOREN_ON & _IESO_ON & _FCMEN_ON & _LVP_OFF
; CONFIG2
; __config 0xFFFF
 __CONFIG _CONFIG2, _BOR4V_BOR40V & _WRT_OFF
 
 CAMBIO_COLOR EQU 0x55
 CAMBIO_BRILLO EQU 0xAA
 MODO_AUTO EQU 0xFF
 
 CBLOCK 0x20
 R_CONTA
 R_CONTB
 ENDC
 
 ORG 0
 SETUP:
    BSF STATUS,RP0
    BCF STATUS,RP1	;BANCO 1.
    BCF TRISC,6 
    BSF TRISC,7
    MOVLW D'00000111'
    MOVWF TRISD
    MOVLW D'25'		;2400 BAUDIOS.
    MOVWF SPBRG
    MOVLW B'00100000'
    MOVWF TXSTA
    BCF STATUS,RP0	;BANCO 0.
    CLRF PORTD
    MOVLW B'10010000'
    MOVWF RCSTA
    MOVLW D'00110000'
    MOVWF T1CON
PROGRAMA:
    BTFSC PORTD,0
    GOTO CAMBIO_RGB
    BTFSC PORTD,1
    GOTO CAMBIO_PWM
    BTFSC PORTD,2
    GOTO CAMBIO_AUTO
    GOTO PROGRAMA 

CAMBIO_RGB:
    BTFSC PORTD,0
    GOTO CAMBIO_RGB
    MOVLW CAMBIO_COLOR
    MOVWF TXREG
    CALL RETARDO_20MS
    GOTO PROGRAMA
    
CAMBIO_PWM:
    BTFSC PORTD,1
    GOTO CAMBIO_PWM
    MOVLW CAMBIO_BRILLO
    MOVWF TXREG
    CALL RETARDO_20MS
    GOTO PROGRAMA
    
CAMBIO_AUTO:
    BTFSC PORTD,2
    GOTO CAMBIO_AUTO
    MOVLW MODO_AUTO
    MOVWF TXREG
    CALL RETARDO_20MS
    GOTO PROGRAMA

RETARDO_20MS:				; La llamada "call" aporta 2 ciclos máquina.
    MOVLW	D'20'			; Aporta 1 ciclo máquina. Este es el valor de "M".
    MOVWF	R_CONTB			; Aporta 1 ciclo máquina.
R1MS_BUCLEEXTERNO:
    MOVLW	D'249'			; Aporta Mx1 ciclos máquina. Este es el valor de "K".	
    MOVWF	R_CONTA			; Aporta Mx1 ciclos máquina.
R1MS_BUCLEINTERNO:
    NOP				; Aporta KxMx1 ciclos máquina.
    DECFSZ	R_CONTA,F		; (K-1)xMx1 cm (cuando no salta) + Mx2 cm (al saltar).
    GOTO	R1MS_BUCLEINTERNO	; Aporta (K-1)xMx2 ciclos máquina.
    DECFSZ	R_CONTB,F		; (M-1)x1 cm (cuando no salta) + 2 cm (al saltar).
    GOTO	R1MS_BUCLEEXTERNO	; Aporta (M-1)x2 ciclos máquina.
    RETURN
    END